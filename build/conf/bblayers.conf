## build/conf/bblayers.conf
```bitbake
# LAYER_CONF_VERSION is increased each time build/conf/bblayers.conf
# changes incompatibly
LCONF_VERSION = "5"

BBPATH = "${TOPDIR}"
BBFILES ?= ""

BBLAYERS ?= " \
    ${TOPDIR}/../oe-udaq/openembedded-core/meta \
    ${TOPDIR}/../oe-udaq/meta-openembedded/meta-oe \
    ${TOPDIR}/../oe-udaq/meta-openembedded/meta-networking \
    ${TOPDIR}/../oe-udaq/meta-yocto/meta-yocto \
    ${TOPDIR}/../oe-udaq/meta-yocto/meta-yocto-bsp \
    ${TOPDIR}/../oe-udaq/meta-udaq \
    "
```

## build/conf/local.conf
```bitbake
CONF_VERSION = "1"

# Options which affect the image
DISTRO = "udaq"
MACHINE = "beagleboard"
SDKMACHINE = "x86_64"
USER_CLASSES += "buildstats"

# Package up sources downloaded via version control
BB_GENERATE_MIRROR_TARBALLS = "1"

# Options only affecting the build process
BB_NUMBER_THREADS = "4"
PARALLEL_MAKE = "-j 4"
PATCHRESOLVE = "noop"

# Enable debugging tweaks - should be removed once things start to stabilise
EXTRA_IMAGE_FEATURES = "debug-tweaks"

# Monitor space or inodes
BB_DISKMON_DIRS = "\
    STOPTASKS,${TMPDIR},1G,100K \
    STOPTASKS,${DL_DIR},1G,100K \
    STOPTASKS,${SSTATE_DIR},1G,100K \
    ABORT,${TMPDIR},100M,1K \
    ABORT,${DL_DIR},100M,1K \
    ABORT,${SSTATE_DIR},100M,1K"

ENTERPRISE_DISTRO = "1"

PREFERRED_VERSION_linux-yocto = "3.2%"

PRSERV_HOST = "localhost:0"
OE_TERMINAL = "screen"
```
